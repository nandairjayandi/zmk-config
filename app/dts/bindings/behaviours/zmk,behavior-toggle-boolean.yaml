## config/west.yml
```yaml
manifest:

  remotes:
    # - name: zmkfirmware
    #  url-base: https://github.com/zmkfirmware
    # Additional modules containing boards/shields/custom code can be listed here as well
    # See https://docs.zephyrproject.org/3.2.0/develop/west/manifest.html#projects
    # - name: eyelash_corne
    #   url-base: https://github.com/a741725193
    - name: nandairjayandi
      url-base: https://github.com/nandairjayandi
    - name: m165437
      url-base: https://github.com/M165437
    - name: urob
      url-base: https://github.com/urob

  projects:
    - name: zmk
      remote: nandairjayandi
      revision: main
      import: app/west.yml
    - name: zmk-eyelash_corne
      remote: nandairjayandi
      revision: main
    - name: zmk-helpers # from urob
      remote: nandairjayandi
      revision: main
    - name: nice-view-parrot 
      remote: nandairjayandi 
      revision: main 
    - name: zmk-auto-layer
      remote: urob
      revision: main
      
  self:
    path: config
```
