// I am not using HRM combos as I would like to reserve its dedicated use and maintain speedy response 

#include <behaviors.dtsi>

#include "zmk-helpers/helper.h"

&sl {
    release-after-ms = <0>;
    ignore-modifiers;
};

&sk {
  release-after-ms = <2000>;
  // quick-release;
  // display-name = "SK ON";
};

#define SIMPLE_MORPH(NAME, MOD, BINDING1, BINDING2)                            \
  ZMK_MOD_MORPH(NAME, mods = <(MOD_L##MOD | MOD_R##MOD)>;                      \
                bindings = <BINDING1>, <BINDING2>;)

MAKE_HT(ht_kp, &kp, &kp)

#define COMBO_TERM_FAST 18
#define COMBO_TERM_SLOW 30

#define COMBO_IDLE_FAST 150
#define COMBO_IDLE_SLOW 50

/* Combos */
ZMK_COMBO(combo_semi,               &kp SEMI,           RT2 RT3, 0, 45)
ZMK_COMBO(combo_and,                 &morph_and,          LT2 LT3, 0, 45)
ZMK_COMBO(combo_bral,               &morph_bral,        LM3 LM2,  1, 45)
ZMK_COMBO(combo_brar,               &morph_brar,        LM2 LM1,  1, 45)

// Typing Combos
ZMK_COMBO(combo_capsword,           &caps_word,         LH1 RH1, 0, 60)
ZMK_COMBO(combo_esc,                &kp ESC,            LH0 RH0, 0 1 2, 60)
ZMK_COMBO(combo_undo,               &kp LG(Z),          LB1 LB2, 0)
ZMK_COMBO(combo_redo,               &kp LG(LS(Z)),      RB1 RB2, 0)

// macOS move combo 
ZMK_COMBO(combo_char,               &kp LC(LG(SPACE)),  LT5 RT5, 0)
ZMK_COMBO(combo_menu,               &kp LG(LS(FSLH)),   RB1 RB3, 2)

// VIM navigation combo 
ZMK_COMBO(combo_vim_jump_left,      &ht_kp PG_UP LBRC,  RT2 RT1, 2)
ZMK_COMBO(combo_vim_jump_right,     &ht_kp PG_DN RBRC,  RT2 RT3, 2)

ZMK_COMBO(combo_vim_word_left,      &ht_kp HOME B,      RM2 RM1, 2)
ZMK_COMBO(combo_vim_word_right,     &ht_kp END E,       RM2 RM3, 2)

// Layer Navigation Combo   
ZMK_COMBO(combo_sys,                &tog 4,             LB5 RB5, 0)
ZMK_COMBO(combo_fn,                 &tog 3,             LM5 RM5, 0)
ZMK_COMBO(combo_home_layer,         &to 0,              LH2 RH2, 1 2 3 4)
ZMK_COMBO(combo_number,             &tog 1,             LM5 LH1)
ZMK_COMBO(combo_nav,                &tog 2,             RM5 RH1)

/* Simple Morph */
// Graphite Specific Morph
SIMPLE_MORPH(morph_comma,   SFT, &kp COMMA, &kp QMARK)          // ,?
SIMPLE_MORPH(morph_dot,     SFT, &kp DOT, &kp EXCL)          // .!
SIMPLE_MORPH(morph_sqt,     SFT, &kp SQT, &kp UNDER)              // '_
SIMPLE_MORPH(morph_fslh,    SFT, &kp FSLH, &kp PRCNT)        // /%
SIMPLE_MORPH(morph_min,     SFT, &kp MINUS, &kp DQT)              // -"

// NUMBER layer morph
SIMPLE_MORPH(morph_eql,     SFT, &kp KP_EQUAL, &kp COMMA)        // =.

// Backspace/Delete Morph
SIMPLE_MORPH(morph_bspc,    SFT, &kp BSPC, &kp DELETE)           // BSPC DEL

SIMPLE_MORPH(morph_and,      SFT, &kp AMPS, &kp AT)
SIMPLE_MORPH(morph_hash,    SFT, &kp HASH, &kp DLLR)

// Bracket Morph
// combine shift modifier and tap-dance to change the bracket form transmitted
SIMPLE_MORPH(morph_bral,    SFT, &tap_bral_one, &tap_bral_two)
SIMPLE_MORPH(morph_brar,    SFT, &tap_brar_one, &tap_brar_two)

/* Tap Dance */
// Bracket Tap Dance 
ZMK_TAP_DANCE(tap_bral_one,     tapping-term-ms = <280>; bindings = <&kp LPAR>, <&kp LBKT>;) // ( [
ZMK_TAP_DANCE(tap_bral_two,     tapping-term-ms = <280>; bindings = <&kp LBRC>, <&kp LT>;) // { < 

ZMK_TAP_DANCE(tap_brar_one,     tapping-term-ms = <280>; bindings = <&kp RPAR>, <&kp RBKT>;) // ) ]
ZMK_TAP_DANCE(tap_brar_two,     tapping-term-ms = <280>; bindings = <&kp RBRC>, <&kp GT>;) // } >

// Screenshot Tap Dance
ZMK_TAP_DANCE(tap_shot_part,    tapping-term-ms = <200>; bindings = <&kp LG(LS(LC(N4)))>, <&kp LG(LS(N4))>;)
ZMK_TAP_DANCE(tap_shot_full,    tapping-term-ms = <200>; bindings = <&kp LG(LS(LC(N3)))>, <&kp LG(LS(N3))>;)

ZMK_TAP_DANCE(tap_copy_cut,     tapping-term-ms = <200>; bindings = <&kp LG(C)>, <&kp LG(X)>;)
ZMK_TAP_DANCE(tap_paste_move,   tapping-term-ms = <200>; bindings = <&kp LG(V)>, <&kp LG(LA(V))>;)

// Meh and HYPR Dance 
ZMK_TAP_DANCE(tap_meh_hypr,   tapping-term-ms = <200>; bindings = <&sk LC(LA(LSHFT))>, <&sk LC(LA(LG(LSHFT)))>;)

// alias list
#define M_FSLH &morph_fslh
#define M_MIN &morph_min
#define M_SQT &morph_sqt
#define M_EQL &morph_eql
#define M_BSPC &morph_bspc
#define M_BRAL &morph_bral
#define M_BRAR &morph_brar
#define M_GRAVE &kp GRAVE
#define M_HASH &morph_hash
#define T_COPY &tap_copy_cut
#define T_PASTE &tap_paste_move
#define T_SUPER &tap_meh_hypr
#define MAC_ALL &kp LG(A)

/* Templates */

// this is dual function that results in different keycode when different modifier is used
// SIMPLE_MORPH(comma_morph, SFT, &kp COMMA, &comma_inner_morph)
// SIMPLE_MORPH(comma_inner_morph, CTL, &kp SEMI, &kp BSLH)