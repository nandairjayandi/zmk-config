/* contains configuration and macro helper for layer setup */

#include <behaviors.dtsi>

#include "zmk-helpers/helper.h"

#define QUICK_TAP_MS 175

// &sl {
//     release-after-ms = <3000>;
//     ignore-modifiers;
// };

// &sk {
//   release-after-ms = <8000>;
//   // quick-release;
//   // display-name = "SK ON";
// };

#define MAKE_HT(NAME, HOLD, TAP)                                             \
  ZMK_HOLD_TAP(NAME, bindings = <HOLD>, <TAP>;                           \
                flavor = "balanced";                                          \
                tapping-term-ms = <200>; quick-tap-ms = <QUICK_TAP_MS>;)

#define MAKE_HRM(NAME, HOLD, TAP, TRIGGER_POS)                                 \
  ZMK_HOLD_TAP(NAME, bindings = <HOLD>, <TAP>; flavor = "balanced";            \
               tapping-term-ms = <200>; quick-tap-ms = <QUICK_TAP_MS>;         \
               require-prior-idle-ms = <100>; hold-trigger-on-release;         \
               hold-trigger-key-positions = <TRIGGER_POS>;)

MAKE_HRM(hml, &kp, &kp, KEYS_R THUMBS) // Left-hand HRMs.
MAKE_HRM(hmr, &kp, &kp, KEYS_L THUMBS) // Right-hand HRMs.

MAKE_HT(ht_nav_bspc, &mo, &morph_bspc)

MAKE_HT(ht_comma_fn, &mo, &morph_comma)
MAKE_HT(ht_dot_fn, &mo, &morph_dot)

// MAKE_HT(ht_mo_sk, &kp, &sk)

#define SK_STOP &kp LANG9 // cancels Sticky Key 

#define L_FN &ht_dot_fn 3 0
#define R_FN &ht_comma_fn  3 0

#define SPC_NUM &lt 1 SPACE
#define BSPC_NAV &ht_nav_bspc 2 0

/ {
	behaviors {
    caps_word: caps_word {
      compatible = "zmk,behavior-caps-word";
      #binding-cells = <0>;
      continue-list = <BACKSPACE MINUS UNDER PERIOD SLASH PERIOD>;
      // ignore-modifiers; 
    };
	};
};